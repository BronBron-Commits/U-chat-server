## firmware/sdkconfig.defaults
```kconfig
# ESP-IDF SDK Configuration Defaults
# ============================================================================
# These settings configure the ESP-IDF build for Unhidra firmware
# ============================================================================

# ----------------------------------------------------------------------------
# Memory Configuration
# ----------------------------------------------------------------------------
# Increase main task stack size for Rust runtime
CONFIG_ESP_MAIN_TASK_STACK_SIZE=32768

# Enable PSRAM if available (for larger heap)
# CONFIG_ESP32_SPIRAM_SUPPORT=y
# CONFIG_SPIRAM_USE_MALLOC=y

# ----------------------------------------------------------------------------
# Wi-Fi Configuration
# ----------------------------------------------------------------------------
# Enable Wi-Fi station mode
CONFIG_ESP_WIFI_MODE_STA=y

# Maximum Wi-Fi TX power (improve range)
CONFIG_ESP_PHY_MAX_WIFI_TX_POWER=20

# Enable power save mode for battery operation
# CONFIG_ESP_WIFI_SLP_IRAM_OPT=y

# Wi-Fi NVS for credential storage
CONFIG_ESP_WIFI_NVS_ENABLED=y

# ----------------------------------------------------------------------------
# TLS/SSL Configuration (Critical for WSS Security)
# ----------------------------------------------------------------------------
# Use mbedTLS for cryptographic operations
CONFIG_MBEDTLS_SSL_MAX_CONTENT_LEN=16384

# Enable TLS 1.2 and 1.3
CONFIG_MBEDTLS_SSL_PROTO_TLS1_2=y
CONFIG_MBEDTLS_SSL_PROTO_TLS1_3=y

# Enable server certificate verification
CONFIG_ESP_TLS_INSECURE=n
CONFIG_ESP_TLS_SKIP_SERVER_CERT_VERIFY=n

# Use certificate bundle for CA verification
CONFIG_MBEDTLS_CERTIFICATE_BUNDLE=y
CONFIG_MBEDTLS_CERTIFICATE_BUNDLE_DEFAULT_FULL=y

# Enable strong cipher suites
CONFIG_MBEDTLS_KEY_EXCHANGE_ECDHE_ECDSA=y
CONFIG_MBEDTLS_KEY_EXCHANGE_ECDHE_RSA=y
CONFIG_MBEDTLS_KEY_EXCHANGE_ECDH_ECDSA=y
CONFIG_MBEDTLS_KEY_EXCHANGE_ECDH_RSA=y

# AES hardware acceleration
CONFIG_MBEDTLS_HARDWARE_AES=y
CONFIG_MBEDTLS_HARDWARE_SHA=y

# ----------------------------------------------------------------------------
# WebSocket Client Configuration
# ----------------------------------------------------------------------------
# Enable WebSocket client component
CONFIG_ESP_WEBSOCKET_CLIENT_ENABLE=y

# WebSocket buffer sizes
CONFIG_WEBSOCKET_CLIENT_TASK_STACK=8192

# Enable ping/pong keep-alive
CONFIG_WS_TRANSPORT_PING_PONG=y

# ----------------------------------------------------------------------------
# HTTP/HTTPS Configuration
# ----------------------------------------------------------------------------
# Enable HTTPS support
CONFIG_ESP_HTTP_CLIENT_ENABLE_HTTPS=y
CONFIG_ESP_HTTP_CLIENT_ENABLE_BASIC_AUTH=y

# ----------------------------------------------------------------------------
# NVS (Non-Volatile Storage) Configuration
# ----------------------------------------------------------------------------
# Enable NVS encryption for secure credential storage
# CONFIG_NVS_ENCRYPTION=y

# NVS partition size
CONFIG_PARTITION_TABLE_CUSTOM=n

# ----------------------------------------------------------------------------
# Logging Configuration
# ----------------------------------------------------------------------------
# Log level: INFO for production, DEBUG for development
CONFIG_LOG_DEFAULT_LEVEL_INFO=y
# CONFIG_LOG_DEFAULT_LEVEL_DEBUG=y

# Enable colored log output
CONFIG_LOG_COLORS=y

# Timestamp in logs
CONFIG_LOG_TIMESTAMP_SOURCE_RTOS=y

# ----------------------------------------------------------------------------
# System Configuration
# ----------------------------------------------------------------------------
# Watchdog timeout
CONFIG_ESP_TASK_WDT_TIMEOUT_S=30

# Enable brownout detector
CONFIG_ESP_BROWNOUT_DET=y

# CPU frequency
CONFIG_ESP_DEFAULT_CPU_FREQ_MHZ_240=y

# ----------------------------------------------------------------------------
# Panic Handler
# ----------------------------------------------------------------------------
# Print registers and backtrace on panic
CONFIG_ESP_SYSTEM_PANIC_PRINT_REBOOT=y

# Reboot after panic (for field reliability)
CONFIG_ESP_SYSTEM_PANIC_REBOOT_DELAY_SECONDS=3

# ----------------------------------------------------------------------------
# Partition Table
# ----------------------------------------------------------------------------
# Use default partition table (can customize for OTA)
CONFIG_PARTITION_TABLE_SINGLE_APP=y
# For OTA support, use:
# CONFIG_PARTITION_TABLE_TWO_OTA=y

# ----------------------------------------------------------------------------
# OTA Updates (Future Enhancement)
# ----------------------------------------------------------------------------
# CONFIG_BOOTLOADER_APP_ROLLBACK_ENABLE=y
# CONFIG_APP_ROLLBACK_ENABLE=y

# ----------------------------------------------------------------------------
# Security Features
# ----------------------------------------------------------------------------
# Enable flash encryption (production)
# CONFIG_SECURE_FLASH_ENC_ENABLED=y

# Enable secure boot (production)
# CONFIG_SECURE_BOOT=y
# CONFIG_SECURE_BOOT_V2_ENABLED=y

# Disable JTAG in production
# CONFIG_SECURE_DISABLE_ROM_JTAG=y
```
